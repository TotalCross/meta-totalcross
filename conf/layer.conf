## conf/layer.conf
```bitbake
# We have a conf and classes directory, add to BBPATH
BBPATH .= ":${LAYERDIR}"

# We have recipes-* directories, add to BBFILES
BBFILES += "${LAYERDIR}/recipes-*/*/*.bb \
            ${LAYERDIR}/recipes-*/*/*.bbappend"

BBFILE_COLLECTIONS += "meta-totalcross"
BBFILE_PATTERN_meta-totalcross = "^${LAYERDIR}/"
BBFILE_PRIORITY_meta-totalcross = "6"

LAYERDEPENDS_meta-totalcross = "core browser-layer meta-java meta-python2"
LAYERSERIES_COMPAT_meta-totalcross = "dunfell gatesgarth"
```
